## TODO_Bkup_17122024/Harman-PNP-Driver/CS-Per-Word-Verified-27012022-1000hrs/mir_spi_flash/Kconfig
```kconfig
menu "MIR SPI FLASH DRIVER MICROCHIP ST25"

 config MIR_SPI_FLASH
         tristate "Mir's Microchip SPI flash driver"
         help
           Microchip SPI flash  driver.
endmenu
```
